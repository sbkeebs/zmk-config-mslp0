## boards/shields/morningstar_lp0/Kconfig.defconfig
```kconfig
if SHIELD_MORNINGSTAR_LP0

config ZMK_KEYBOARD_NAME
    default "morningstar_lp0"

endif # SHIELD_MORNINGSTAR_LP0
```

## boards/shields/morningstar_lp0/Kconfig.shield
```kconfig
config SHIELD_MORNINGSTAR_LP0
    def_bool $(shields_list_contains,morningstar_lp0)
```

## boards/shields/mslp0/Kconfig.defconfig
```kconfig
if SHIELD_MSLP0

config ZMK_KEYBOARD_NAME
    default "mslp0"

endif # SHIELD_MSLP0
```

## boards/shields/mslp0/scratch/morningstarlp/Kconfig.defconfig
```kconfig
if SHIELD_MORNINGSTARLP

config ZMK_KEYBOARD_NAME
    default "Morningstar LP"

endif
```

## boards/shields/mslp0/scratch/morningstarlp/Kconfig.shield
```kconfig
config SHIELD_MORNINGSTARLP
    def_bool $(shields_list_contains,morningstarlp)
    
```
